## rs125_dash_rewrite/rs125_dash/sdkconfig.defaults
```kconfig
CONFIG_IDF_TARGET="esp32s3"
CONFIG_ESPTOOLPY_FLASHSIZE_8MB=y
CONFIG_SPIRAM=y
CONFIG_SPIRAM_MODE_OCT=y
CONFIG_SPIRAM_SPEED_80M=y
CONFIG_SPIRAM_USE_MALLOC=y
CONFIG_LV_MEM_CUSTOM=y
CONFIG_LV_DISP_DEF_REFR_PERIOD=16
CONFIG_LV_COLOR_DEPTH_16=y
CONFIG_LV_USE_LOG=y
```
